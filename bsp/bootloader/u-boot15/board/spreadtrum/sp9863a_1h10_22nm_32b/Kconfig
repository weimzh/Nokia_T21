## bsp/bootloader/u-boot15/board/spreadtrum/sp9863a_1h10_22nm_32b/Kconfig
```kconfig
if TARGET_SP9863A_1H10_22NM_32B

config SYS_BOARD
	default "sp9863a_1h10_22nm_32b"

config SYS_VENDOR
	default "spreadtrum"

config SYS_SOC
	default "sharkl3"

config SYS_CONFIG_NAME
	default "sp9863a_1h10_22nm_32b"

config SYS_TEXT_BASE
	default 0x9f000000

endif
```

## bsp/bootloader/u-boot15/board/spreadtrum/sp9863a_1h10_go/Kconfig
```kconfig
if TARGET_SP9863A_1H10_GO

config SYS_BOARD
	default "sp9863a_1h10_go"

config SYS_VENDOR
	default "spreadtrum"

config SYS_SOC
	default "sharkl3"

config SYS_CONFIG_NAME
	default "sp9863a_1h10_go"

config SYS_TEXT_BASE
	default 0x9f000000

endif
```

## bsp/bootloader/u-boot15/board/spreadtrum/sp9863a_test/Kconfig
```kconfig
if TARGET_SP9863A_TEST

config SYS_BOARD
	default "sp9863a_test"

config SYS_VENDOR
	default "spreadtrum"

config SYS_SOC
	default "sharkl3"

config SYS_CONFIG_NAME
	default "sp9863a_test"

config SYS_TEXT_BASE
	default 0x9f000000

endif
```

## bsp/bootloader/u-boot15/board/spreadtrum/udx710_3h10_pi/Kconfig
```kconfig
if TARGET_UDX710_3H10_PI

config SYS_BOARD
	default "udx710_3h10_pi"

config SYS_VENDOR
	default "spreadtrum"

config SYS_SOC
	default "orca"

config SYS_CONFIG_NAME
	default "udx710_3h10_pi"

config SYS_TEXT_BASE
	default 0x9f000000

endif
```

## bsp/bootloader/u-boot15/board/spreadtrum/ums312_2h10_go/Kconfig
```kconfig
if TARGET_UMS312_2H10_GO

config SYS_BOARD
	default "ums312_2h10_go"

config SYS_VENDOR
	default "spreadtrum"

config SYS_SOC
	default "sharkl5"

config SYS_CONFIG_NAME
	default "ums312_2h10_go"

config SYS_TEXT_BASE
	default 0x9f000000

endif
```

## bsp/bootloader/u-boot15/board/spreadtrum/ums512_1h10_go/Kconfig
```kconfig
if TARGET_UMS512_1H10_GO

config SYS_BOARD
	default "ums512_1h10_go"

config SYS_VENDOR
	default "spreadtrum"

config SYS_SOC
	default "sharkl5pro"

config SYS_CONFIG_NAME
	default "ums512_1h10_go"

config SYS_TEXT_BASE
	default 0x9f000000

endif
```

## bsp/bootloader/u-boot15/board/spreadtrum/ums512_test/Kconfig
```kconfig
if TARGET_UMS512_TEST

config SYS_BOARD
	default "ums512_test"

config SYS_VENDOR
	default "spreadtrum"

config SYS_SOC
	default "sharkl5pro"

config SYS_CONFIG_NAME
	default "ums512_test"

config SYS_TEXT_BASE
	default 0x9f000000

endif
```

## bsp/bootloader/u-boot15/board/spreadtrum/ums9230_14c10/Kconfig
```kconfig
if TARGET_UMS9230_14C10

config SYS_BOARD
	default "ums9230_14c10"

config SYS_VENDOR
	default "spreadtrum"

config SYS_SOC
	default "qogirl6"

config SYS_CONFIG_NAME
	default "ums9230_14c10"

config SYS_TEXT_BASE
	default 0x9f000000

endif
```

## bsp/bootloader/u-boot15/board/spreadtrum/ums9230_1h10_go/Kconfig
```kconfig
if TARGET_UMS9230_1H10_GO

config SYS_BOARD
	default "ums9230_1h10_go"

config SYS_VENDOR
	default "spreadtrum"

config SYS_SOC
	default "qogirl6"

config SYS_CONFIG_NAME
	default "ums9230_1h10_go"

config SYS_TEXT_BASE
	default 0x9f000000

endif
```

## bsp/bootloader/u-boot15/board/spreadtrum/ums9230_3h10_go/Kconfig
```kconfig
if TARGET_UMS9230_3H10_GO

config SYS_BOARD
	default "ums9230_3h10_go"

config SYS_VENDOR
	default "spreadtrum"

config SYS_SOC
	default "qogirl6"

config SYS_CONFIG_NAME
	default "ums9230_3h10_go"

config SYS_TEXT_BASE
	default 0x9f000000

endif
```

## bsp/bootloader/u-boot15/board/spreadtrum/ums9230_4h10/Kconfig
```kconfig
if TARGET_UMS9230_4H10

config SYS_BOARD
	default "ums9230_4h10"

config SYS_VENDOR
	default "spreadtrum"

config SYS_SOC
	default "qogirl6"

config SYS_CONFIG_NAME
	default "ums9230_4h10"

config SYS_TEXT_BASE
	default 0x9f000000

endif
```

## bsp/bootloader/u-boot15/board/spreadtrum/ums9230_4h10_go/Kconfig
```kconfig
if TARGET_UMS9230_4H10_GO

config SYS_BOARD
	default "ums9230_4h10_go"

config SYS_VENDOR
	default "spreadtrum"

config SYS_SOC
	default "qogirl6"

config SYS_CONFIG_NAME
	default "ums9230_4h10_go"

config SYS_TEXT_BASE
	default 0x9f000000

endif
```

## bsp/bootloader/u-boot15/board/spreadtrum/ums9230_haps_flash/Kconfig
```kconfig
if TARGET_UMS9230_HAPS_FLASH

config SYS_BOARD
	default "ums9230_haps_flash"

config SYS_VENDOR
	default "spreadtrum"

config SYS_SOC
	default "qogirl6"

config SYS_CONFIG_NAME
	default "ums9230_haps_flash"

config SYS_TEXT_BASE
	default 0x9f000000

endif
```

## bsp/bootloader/u-boot15/board/spreadtrum/ums9230_zebu/Kconfig
```kconfig
if TARGET_UMS9230_ZEBU

config SYS_BOARD
	default "ums9230_zebu"

config SYS_VENDOR
	default "spreadtrum"

config SYS_SOC
	default "qogirl6"

config SYS_CONFIG_NAME
	default "ums9230_zebu"

config SYS_TEXT_BASE
	default 0x9f000000

endif
```

## bsp/bootloader/u-boot15/board/spreadtrum/ums9520_haps/Kconfig
```kconfig
if TARGET_UMS9520_HAPS

config SYS_BOARD
	default "ums9520_haps"

config SYS_VENDOR
	default "spreadtrum"

config SYS_SOC
	default "qogirn6pro"

config SYS_CONFIG_NAME
	default "ums9520_haps"

config SYS_TEXT_BASE
	default 0xb5000000

endif
```

## bsp/bootloader/u-boot15/board/spreadtrum/ums9520_haps_flash/Kconfig
```kconfig
if TARGET_UMS9520_HAPS_FLASH

config SYS_BOARD
	default "ums9520_haps_flash"

config SYS_VENDOR
	default "spreadtrum"

config SYS_SOC
	default "qogirn6pro"

config SYS_CONFIG_NAME
	default "ums9520_haps_flash"

config SYS_TEXT_BASE
	default 0xb5000000

endif
```

## bsp/bootloader/u-boot15/board/spreadtrum/ums9520_zebu/Kconfig
```kconfig
if TARGET_UMS9520_ZEBU

config SYS_BOARD
	default "ums9520_zebu"

config SYS_VENDOR
	default "spreadtrum"

config SYS_SOC
	default "qogirn6pro"

config SYS_CONFIG_NAME
	default "ums9520_zebu"

config SYS_TEXT_BASE
	default 0x9f000000

endif
```

## bsp/bootloader/u-boot15/board/spreadtrum/ums9620_1h10/Kconfig
```kconfig
if TARGET_UMS9620_1H10

config SYS_BOARD
	default "ums9620_1h10"

config SYS_VENDOR
	default "spreadtrum"

config SYS_SOC
	default "qogirn6pro"

config SYS_CONFIG_NAME
	default "ums9620_1h10"

config SYS_TEXT_BASE
	default 0xb5000000

endif
```

## bsp/bootloader/u-boot15/board/spreadtrum/ums9620_2c11/Kconfig
```kconfig
if TARGET_UMS9620_2C11

config SYS_BOARD
	default "ums9620_2c11"

config SYS_VENDOR
	default "spreadtrum"

config SYS_SOC
	default "qogirn6pro"

config SYS_CONFIG_NAME
	default "ums9620_2c11"

config SYS_TEXT_BASE
	default 0xb5000000

endif
```

## bsp/bootloader/u-boot15/board/spreadtrum/ums9620_2h10_car/Kconfig
```kconfig
if TARGET_UMS9620_2H10_CAR

config SYS_BOARD
	default "ums9620_2h10_car"

config SYS_VENDOR
	default "spreadtrum"

config SYS_SOC
	default "qogirn6pro"

config SYS_CONFIG_NAME
	default "ums9620_2h10_car"

config SYS_TEXT_BASE
	default 0xb5000000

endif
```

## bsp/bootloader/u-boot15/board/spreadtrum/ums9620_3c10/Kconfig
```kconfig
if TARGET_UMS9620_3C10

config SYS_BOARD
	default "ums9620_3c10"

config SYS_VENDOR
	default "spreadtrum"

config SYS_SOC
	default "qogirn6pro"

config SYS_CONFIG_NAME
	default "ums9620_3c10"

config SYS_TEXT_BASE
	default 0xb5000000

endif
```

## bsp/bootloader/u-boot15/configs/sp7731e_1h10_defconfig
```kconfig
CONFIG_ARM=y
CONFIG_ARCH_SPRD=y
CONFIG_TARGET_SP7731E_1H10=y
CONFIG_OF_CONTROL=y
CONFIG_OF_LIBFDT_OVERLAY=y
# CONFIG_CMD_IMLS is not set
# CONFIG_CMD_NET is not set
CONFIG_DM=y
CONFIG_CLK=y
CONFIG_DM_SC27XX_ADC=y
CONFIG_DM_SPI=y
CONFIG_DM_SPRD_ADI=y
CONFIG_PMIC_CHILDREN=y
CONFIG_DM_PMIC=y
CONFIG_DM_REGULATOR=y
CONFIG_OF_PLATDATA=y
CONFIG_DM_PMIC_SC2720=y
CONFIG_DM_REGULATOR_SC2720=y
CONFIG_DM_SC27XX_EFUSE=y
CONFIG_DM_SPRD_EFUSE=y
CONFIG_DM_SPRD_SPI=y
# CONFIG_MISC is not set
CONFIG_DM_SC27XX_VIBRA=y
# CONFIG_LED is not set
CONFIG_LED_SC27XX=y
CONFIG_LED_BLINK=y
CONFIG_DMA=y
CONFIG_SPRD_DMA=y
CONFIG_DMA_CHANNELS=y
CONFIG_DM_FGU=y
CONFIG_DM_RTC=y
CONFIG_RTC_SC27XX=y
```

## bsp/bootloader/u-boot15/configs/sp7731e_1h20_defconfig
```kconfig
CONFIG_ARM=y
CONFIG_ARCH_SPRD=y
CONFIG_TARGET_SP7731E_1H20=y
CONFIG_OF_CONTROL=y
CONFIG_OF_LIBFDT_OVERLAY=y
# CONFIG_CMD_IMLS is not set
# CONFIG_CMD_NET is not set
CONFIG_DM=y
CONFIG_CLK=y
CONFIG_DM_SC27XX_ADC=y
CONFIG_DM_SPI=y
CONFIG_DM_SPRD_ADI=y
CONFIG_DM_SC27XX_EFUSE=y
CONFIG_DM_SPRD_EFUSE=y
CONFIG_DM_SPRD_SPI=y
# CONFIG_MISC is not set
CONFIG_DM_SC27XX_VIBRA=y
# CONFIG_LED is not set
CONFIG_LED_SC27XX=y
CONFIG_LED_BLINK=y
CONFIG_DMA=y
CONFIG_SPRD_DMA=y
CONFIG_DMA_CHANNELS=y
```

## bsp/bootloader/u-boot15/configs/sp9863a_3c10_defconfig
```kconfig
CONFIG_ARM=y
CONFIG_ARCH_SPRD=y
CONFIG_TARGET_SP9863A_3C10=y
CONFIG_OF_CONTROL=y
CONFIG_OF_LIBFDT_OVERLAY=y
# CONFIG_FPGA=y
# CONFIG_CMD_BDI is not set
# CONFIG_CMD_ECHO is not set
# CONFIG_CMD_FLASH is not set
# CONFIG_CMD_IMI is not set
# CONFIG_CMD_IMLS is not set
# CONFIG_CMD_MEMORY is not set
# CONFIG_CMD_NET is not set
# CONFIG_CMD_RUN is not set
# CONFIG_CMD_SAVEENV is not set
# CONFIG_CMD_SOURCE is not set
CONFIG_DM=y
CONFIG_CLK=y
CONFIG_DM_SC27XX_ADC=y
CONFIG_DM_SPI=y
CONFIG_DM_SPRD_SPI=y
CONFIG_DM_SPRD_ADI=y
CONFIG_DM_SC27XX_EFUSE=y
CONFIG_DM_SPRD_EFUSE=y
CONFIG_DM_SERIAL=y
CONFIG_SERIAL_PRESENT=y
# CONFIG_MISC is not set
CONFIG_DM_SC27XX_VIBRA=y
# CONFIG_LED is not set
CONFIG_LED_SC27XX=y
CONFIG_LED_BLINK=y
CONFIG_DMA=y
CONFIG_SPRD_DMA=y
CONFIG_DMA_CHANNELS=y
```

## bsp/bootloader/u-boot15/configs/ums512_fuzz_defconfig
```kconfig
CONFIG_ARM=y
CONFIG_ARCH_SPRD=y
CONFIG_TARGET_UMS512_1H10=y
CONFIG_OF_CONTROL=y
# CONFIG_FPGA=y
CONFIG_OF_LIBFDT_OVERLAY=y
# CONFIG_CMD_BDI is not set
# CONFIG_CMD_ECHO is not set
# CONFIG_CMD_FLASH is not set
# CONFIG_CMD_IMI is not set
# CONFIG_CMD_IMLS is not set
# CONFIG_CMD_MEMORY is not set
# CONFIG_CMD_NET is not set
# CONFIG_CMD_RUN is not set
# CONFIG_CMD_SAVEENV is not set
# CONFIG_CMD_SOURCE is not set
CONFIG_DM=y
CONFIG_CLK=y
CONFIG_DM_SC27XX_ADC=y
CONFIG_DM_SPI=y
CONFIG_DM_SPRD_SPI=y
CONFIG_DM_SPRD_ADI=y
CONFIG_PMIC_CHILDREN=y
CONFIG_DM_PMIC=y
CONFIG_DM_REGULATOR=y
CONFIG_OF_PLATDATA=y
CONFIG_DM_PMIC_SC2730=y
CONFIG_DM_REGULATOR_SC2730=y
CONFIG_DM_SC27XX_EFUSE=y
CONFIG_DM_SPRD_EFUSE=y
CONFIG_DM_DSPBOOT=y
# CONFIG_DM_SERIAL=y
# CONFIG_SERIAL_PRESENT=y
# CONFIG_MISC is not set
CONFIG_DM_SC27XX_VIBRA=y
# CONFIG_LED is not set
CONFIG_LED_SC27XX=y
CONFIG_LED_BLINK=y
CONFIG_DMA=y
CONFIG_SPRD_DMA=y
CONFIG_DMA_CHANNELS=y
CONFIG_DM_FGU=y
CONFIG_DM_RTC=y
CONFIG_RTC_SC27XX=y
CONFIG_DM_I2C=y
CONFIG_FAN54015_CHARGE_IC=y
```
