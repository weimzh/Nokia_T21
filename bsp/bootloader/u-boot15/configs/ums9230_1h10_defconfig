## bsp/bootloader/u-boot15/configs/ums9230_1h10_defconfig
```kconfig
CONFIG_ARM=y
CONFIG_ARCH_SPRD=y
CONFIG_TARGET_UMS9230_1H10=y
CONFIG_OF_CONTROL=y
CONFIG_OF_LIBFDT_OVERLAY=y
# CONFIG_CMD_BDI is not set
# CONFIG_CMD_ECHO is not set
# CONFIG_CMD_FLASH is not set
# CONFIG_CMD_IMI is not set
# CONFIG_CMD_IMLS is not set
# CONFIG_CMD_MEMORY is not set
# CONFIG_CMD_NET is not set
# CONFIG_CMD_RUN is not set
# CONFIG_CMD_SAVEENV is not set
# CONFIG_CMD_SOURCE is not set
# CONFIG_DM_SERIAL is not set
CONFIG_DM=y
CONFIG_CLK=y
CONFIG_DM_I2C=y
# CONFIG_BQ2560X_CHARGE_IC is not set
CONFIG_SGM41513A_CHARGE_IC=y
```

## bsp/bootloader/u-boot15/configs/ums9520_haps_flash_defconfig
```kconfig
CONFIG_ARM=y
CONFIG_ARCH_SPRD=y
CONFIG_TARGET_UMS9520_HAPS_FLASH=y
CONFIG_OF_CONTROL=y
CONFIG_FPGA=y
CONFIG_OF_LIBFDT_OVERLAY=y
# CONFIG_CMD_BDI is not set
# CONFIG_CMD_ECHO is not set
# CONFIG_CMD_FLASH is not set
# CONFIG_CMD_IMI is not set
# CONFIG_CMD_IMLS is not set
# CONFIG_CMD_MEMORY is not set
# CONFIG_CMD_NET is not set
# CONFIG_CMD_RUN is not set
# CONFIG_CMD_SAVEENV is not set
# CONFIG_CMD_SOURCE is not set
```

## bsp/bootloader/u-boot15/configs/ums9620_2h10_defconfig
```kconfig
CONFIG_ARM=y
CONFIG_ARCH_SPRD=y
CONFIG_TARGET_UMS9620_2H10=y
CONFIG_OF_CONTROL=y
CONFIG_OF_LIBFDT_OVERLAY=y
# CONFIG_CMD_BDI is not set
# CONFIG_CMD_ECHO is not set
# CONFIG_CMD_FLASH is not set
# CONFIG_CMD_IMI is not set
# CONFIG_CMD_IMLS is not set
# CONFIG_CMD_MEMORY is not set
# CONFIG_CMD_NET is not set
# CONFIG_CMD_RUN is not set
# CONFIG_CMD_SAVEENV is not set
# CONFIG_CMD_SOURCE is not set
CONFIG_DM=y
CONFIG_CLK=y
CONFIG_DM_I2C=y
CONFIG_BQ2560X_CHARGE_IC=y
CONFIG_DM_SPRD_EFUSE=y
```

## bsp/bootloader/u-boot15/drivers/dspboot/Kconfig
```kconfig
config DM_DSPBOOT
	bool "Enable Driver Model for DSPBOOT drivers"
	depends on DM
	help
	  Enable driver model for DSPBOOT access.

config CMD_UBOOT_IT_DSPBOOT_TEST
	bool "Sprd DSPBOOT driver test"
	help
	  This driver can be used to test the Sprd dspboot driver.
```

## bsp/bootloader/u-boot15/drivers/power/battery/Kconfig
```kconfig
config DM_FGU
	bool "Enable Driver Model for FGU drivers (UCLASS_FGU)"
	depends on DM
	---help---
	This config enables the driver-model FGU support.
	UCLASS_FGU - designed to provide an I/O interface for FGU devices.

config FAN54015_CHARGE_IC
	bool "allow to use the fan54015 charge IC"
	---help---
	This allows to use the fan54015 charge IC.

config BQ2560X_CHARGE_IC
	bool "allow to use the bq2560x charge IC"
	---help---
	This allows to use the bq2560x charge IC.

config SGM41511_CHARGE_IC
	bool "allow to use the sgm41511 charge IC"
	---help---
	This allows to use the sgm41511 charge IC.
config SGM41513A_CHARGE_IC
	bool "allow to use the SGM41513A charge IC"
	---help---
	This allows to use the SGM41513A charge IC.
```

## bsp/bootloader/u-boot15/drivers/power/pmic/Kconfig
```kconfig
config DM_PMIC
	bool "Enable Driver Model for PMIC drivers (UCLASS_PMIC)"
	depends on DM
	---help---
	This config enables the driver-model PMIC support.
	UCLASS_PMIC - designed to provide an I/O interface for PMIC devices.
	For the multi-function PMIC devices, this can be used as parent I/O
	device for each IC's interface. Then, each children uses its parent
	for read/write. For detailed description, please refer to the files:
	- 'drivers/power/pmic/pmic-uclass.c'
	- 'include/power/pmic.h'

config PMIC_CHILDREN
	bool "Allow child devices for PMICs"
	depends on DM_PMIC
	default y
	---help---
	This allows PMICs to support child devices (such as regulators) in
	SPL. This adds quite a bit of code so if you are not using this
	feature you can turn it off. Most likely you should turn it on for
	U-Boot proper.

config SPL_PMIC_CHILDREN
	bool "Allow child devices for PMICs in SPL"
	depends on DM_PMIC
	default y
	---help---
	This allows PMICs to support child devices (such as regulators) in
	SPL. This adds quite a bit of code so if you are not using this
	feature you can turn it off. In this case you may need a 'back door'
	to call your regulator code (e.g. see rk8xx.c for direct functions
	for use in SPL).

config DM_PMIC_MAX77686
	bool "Enable Driver Model for PMIC MAX77686"
	depends on DM_PMIC
	---help---
	This config enables implementation of driver-model pmic uclass features
	for PMIC MAX77686. The driver implements read/write operations.

config DM_PMIC_SC2721
	bool "Enable Driver Model for PMIC SC2721"
	depends on DM_PMIC
	---help---
	This config enables implementation of driver-model pmic uclass features
	for PMIC SC2721. The driver implements read/write operations.

config DM_PMIC_SC2720
	bool "Enable Driver Model for PMIC SC2721"
	depends on DM_PMIC
	---help---
	This config enables implementation of driver-model pmic uclass features
	for PMIC SC2720. The driver implements read/write operations.

config DM_PMIC_SC2730
	bool "Enable Driver Model for PMIC SC2721"
	depends on DM_PMIC
	---help---
	This config enables implementation of driver-model pmic uclass features
	for PMIC SC2730. The driver implements read/write operations.

config DM_PMIC_SANDBOX
	bool "Enable Driver Model for emulated Sandbox PMIC "
	depends on DM_PMIC
	---help---
	Enable the driver for Sandbox PMIC emulation. The emulated PMIC device
	depends on two drivers:
	- sandbox PMIC I/O driver - implements dm pmic operations
	- sandbox PMIC i2c emul driver - emulates the PMIC's I2C transmission

	A detailed information can be found in header: '<power/sandbox_pmic.h>'

	The Sandbox PMIC info:
	* I/O interface:
	  - I2C chip address:       0x40
	  - first register address: 0x0
	  - register count:         0x10
	* Adjustable outputs:
	  - 2x LDO
	  - 2x BUCK
	  - Each, with a different operating conditions (header).
	* Reset values:
	  - set by i2c emul driver's probe() (defaults in header)

	Driver binding info: doc/device-tree-bindings/pmic/sandbox.txt
```

## bsp/kernel/kernel5.4/drivers/misc/st21nfc/Kconfig
```kconfig
#
# ST Microelectronics ST21NFC/ST54 NFC Controller Driver
#
config ST21NFC
	tristate "ST Microelectronics ST21NFC/ST54 NFC Controller Driver"
	default n
	help
		ST Microelectronics ST21NFC Near Field Communication controller support.
```
